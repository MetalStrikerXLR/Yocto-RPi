## build/conf/bblayers.conf
```bitbake
# POKY_BBLAYERS_CONF_VERSION is increased each time build/conf/bblayers.conf
# changes incompatibly
POKY_BBLAYERS_CONF_VERSION = "2"

BBPATH = "${TOPDIR}"
BBFILES ?= ""

BBLAYERS ?= " \
  /home/hamzah/Yocto/sources/poky/meta \
  /home/hamzah/Yocto/sources/poky/meta-poky \
  /home/hamzah/Yocto/sources/poky/meta-yocto-bsp \
  /home/hamzah/Yocto/sources/meta-raspberrypi \
  /home/hamzah/Yocto/sources/meta-openembedded/meta-oe \
  /home/hamzah/Yocto/sources/meta-openembedded/meta-python \
  /home/hamzah/Yocto/sources/meta-openembedded/meta-multimedia \
  /home/hamzah/Yocto/sources/meta-openembedded/meta-networking \
  /home/hamzah/Yocto/sources/meta-development \
  "
```

## sources/meta-development/conf/layer.conf
```bitbake
# We have a conf and classes directory, add to BBPATH
BBPATH .= ":${LAYERDIR}"

# We have a recipes directory containing .bb and .bbappend files, add to BBFILES
BBFILES += "${LAYERDIR}/recipes-*/*/*.bb \
            ${LAYERDIR}/recipes-*/*/*.bbappend"

BBFILE_COLLECTIONS += "meta-development"
BBFILE_PATTERN_meta-development = "^${LAYERDIR}/"
BBFILE_PRIORITY_meta-development = "6"

LAYERDEPENDS_meta-development = "core"
LAYERSERIES_COMPAT_meta-development = "warrior"
```

## sources/meta-development/conf/machine/raspberrypi3-dev-64.conf
```bitbake
#@TYPE: Machine
#@NAME: RaspberryPi 3 Development Board
#@DESCRIPTION: Machine configuration for the RaspberryPi 3 in 64 bits mode

MACHINEOVERRIDES = "raspberrypi3:${MACHINE}"

MACHINE_EXTRA_RRECOMMENDS += "\
    linux-firmware-rpidistro-bcm43430 \
    linux-firmware-rpidistro-bcm43455 \
    bluez-firmware-rpidistro-bcm43430a1-hcd \
    bluez-firmware-rpidistro-bcm4345c0-hcd \
"

require conf/machine/include/tune-cortexa53.inc
include conf/machine/include/rpi-base.inc

RPI_KERNEL_DEVICETREE = " \
    broadcom/bcm2710-rpi-3-b.dtb \
    broadcom/bcm2710-rpi-3-b-plus.dtb \
    broadcom/bcm2837-rpi-3-b.dtb \
    "

SERIAL_CONSOLES ?= "115200;ttyS0"
ENABLE_UART = "1"

UBOOT_MACHINE = "rpi_3_config"

# When u-boot is enabled we need to use the "Image" format and the "booti"
# command to load the kernel
KERNEL_IMAGETYPE_UBOOT ?= "Image"
# "zImage" not supported on arm64 and ".gz" images not supported by bootloader yet
KERNEL_IMAGETYPE_DIRECT ?= "Image"
KERNEL_BOOTCMD ?= "booti"

ARMSTUB ?= "armstub8.bin"

DISTRO_FEATURES += "systemd bluetooth"
DISTRO_FEATURES_remove = "pulseaudio sysvinit"

VIRTUAL-RUNTIME_init_manager = "systemd"
VIRTUAL-RUNTIME_initscripts = ""

#PREFERRED_VERSION_linux-raspberrypi = "4.19.35"
PREFERRED_VERSION_alsa-lib = "1.1.8"
#PREFERRED_VERSION_bluealsa = "4.%"
PREFERRED_VERSION_sbc = "2.%"
```

## sources/meta-rpidev/conf/distro/rpi-dev.conf
```bitbake
require conf/distro/poky.conf

########################################
# Distro Configurations
########################################

ENABLE_UART = "1"
RPI_USE_U_BOOT = "1"

DISTRO_FEATURES += "systemd bluetooth wifi opengl"
DISTRO_FEATURES_remove = "sysvinit"

VIRTUAL-RUNTIME_init_manager = "pulseaudio systemd"
DISTRO_FEATURES_BACKFILL_CONSIDERED = "sysvinit"
VIRTUAL-RUNTIME_initscripts = ""

PREFERRED_PROVIDER_virtual/bootloader = "u-boot"
KERNEL_IMAGETYPE = "zImage"
KERNEL_BOOTCMD = "bootz"

# When u-boot is enabled we need to use the "Image" format and the "booti"
# command to load the kernel for rpi3 64 bits
# ("zImage" not supported on arm64 and ".gz" images not supported by bootloader yet)
KERNEL_IMAGETYPE_raspberrypi3-64="Image"
KERNEL_BOOTCMD_raspberrypi3-64 = "booti"

RM_OLD_IMAGE = "1"
IMAGE_FSTYPES = "rpi-sdimg"
#INHERIT += "rm_work"

########################################
# Package Version Preferrences
########################################

PREFERRED_VERSION_sbc = "2.%"

########################################
# Mender Configurations
########################################

# The name of the disk image and Artifact that will be built.
# This is what the device will report that it is running, and different updates
# must have different names because Mender will skip installation of an Artifact
# if it is already installed.
MENDER_ARTIFACT_NAME = "release-1"

INHERIT += "mender-full"
PACKAGECONFIG_append_pn-mender = " modules"
MENDER_CONNECT_USER ?= "root"
MENDER_CONNECT_SHELL ?= "/bin/bash"

# Build for Hosted Mender
#
# To get your tenant token:
#    - log in to https://hosted.mender.io
#    - click your email at the top right and then "My organization"
#    - press the "COPY TO CLIPBOARD"
#    - assign content of clipboard to MENDER_TENANT_TOKEN
#
MENDER_SERVER_URL = "https://hosted.mender.io"
MENDER_TENANT_TOKEN = "eyJhbGciOiJSUzI1NiIsInR5cCI6IkpXVCJ9.eyJtZW5kZXIudGVuYW50IjoiNjQyMmFkODg2ZjYzN2ExNGM5YzA0MzVjIiwiaXNzIjoiTWVuZGVyIiwic3ViIjoiNjQyMmFkODg2ZjYzN2ExNGM5YzA0MzVjIn0.TwikSPOFiIo9U9OGVuiaqlIhfhI1kDu4ZWNJuTPNMyMMwEsVo3DSMoqhuvCRrl1npF4C_VZ0S-rREcbHN6uajBGUQo7DT05SIFtknxRHsxLKjmM-WO6lNMoZosCEEdgy5V4L6jnPr9xu8Pg1UG0qNL5QMKdM5Ve8eyfSV5M4Qh-oRCov58ZfYqhghKtEmC874AoNm19OOPgycgJ3BBgcrwf5LZBRCr6xbMVphlIXvK6X1CN4cBQC208FGcQf15Jbi3-864ypTkMOZWcnxU-b6Q3l9hdWfAYtM2eQwenwS8xwJRwgEUeYnc_r-vmxkB-AaIOpR5CzFXwu-mXhQmagDpKmT4NfztXIvDryLU7SCjH9KHZrXM8nC3LzP7_H7SJBXTDxQ4309_jBgbQxA6N3jNsCZmZu-v0iZAdz7opYBvV-i_AWKZ-j6wL8932yMqoHAYoSdKGeX5EvWbH1M1GF1xW57dEpg09BXhDk7awYQfmCSMtV7_vAeppX_kDMl94J"

# Mender storage configuration
#
# More details on these variables is available at
#    https://docs.mender.io/devices/yocto-project/partition-configuration#configuring-storage
#
# Also, please be sure to check other config files as other
# layers, config fragments, etc may attempt to set values
# for specific platforms.  Using "bitbake -e <image-name>"
# can help determine which files are setting these values
# in a given configuration.
#
# MENDER_STORAGE_TOTAL_SIZE_MB = "2048"
# MENDER_BOOT_PART_SIZE_MB = "16"
# MENDER_DATA_PART_SIZE_MB = "1024"
# MENDER_STORAGE_DEVICE = "/dev/mmcblk0"
# MENDER_BOOT_PART = "${MENDER_STORAGE_DEVICE_BASE}1"
# MENDER_DATA_PART = "${MENDER_STORAGE_DEVICE_BASE}4"
# MENDER_ROOTFS_PART_A = "${MENDER_STORAGE_DEVICE_BASE}2"
# MENDER_ROOTFS_PART_B = "${MENDER_STORAGE_DEVICE_BASE}3"


# Appended fragment from meta-mender-community/meta-mender-raspberrypi/templates

MENDER_PARTITION_ALIGNMENT = "4194304"
MENDER_BOOT_PART_SIZE_MB = "40"
IMAGE_INSTALL_append = " kernel-image kernel-devicetree"
IMAGE_FSTYPES_remove += " rpi-sdimg wic.gz wic.bmap mender.bmap sdimg.bmap tar.bz2 ext4"

MENDER_FEATURES_ENABLE_append = " mender-uboot mender-image-sd"
MENDER_FEATURES_DISABLE_append = " mender-grub mender-image-uefi"
```

## sources/meta-rpidev/conf/layer.conf
```bitbake
# We have a conf and classes directory, add to BBPATH
BBPATH .= ":${LAYERDIR}"

# We have a recipes directory containing .bb and .bbappend files, add to BBFILES
BBFILES += "${LAYERDIR}/recipes-*/*/*.bb \
            ${LAYERDIR}/recipes-*/*/*.bbappend"

BBFILE_COLLECTIONS += "meta-rpidev"
BBFILE_PATTERN_meta-rpidev = "^${LAYERDIR}/"
BBFILE_PRIORITY_meta-rpidev = "6"

LAYERDEPENDS_meta-rpidev = "core"
LAYERSERIES_COMPAT_meta-rpidev = "warrior"
```
